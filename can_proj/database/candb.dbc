VERSION ""

NS_ :

BS_:

BU_: DOOR2 DOOR

BO_ 1347 doorStatus2: 1 DOOR2
 SG_ door2 : 0|8@1- (1,0) [0|1] "" Vector__XXX

BO_ 531 doorStatus1: 1 DOOR
 SG_ door1 : 0|8@1- (1,0) [0|1] "" Vector__XXX

BA_DEF_  "BusType" STRING ;
BA_DEF_DEF_  "BusType" "CAN";
